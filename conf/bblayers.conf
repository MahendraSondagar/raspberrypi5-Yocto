## conf/bblayers.conf
```bitbake
# POKY_BBLAYERS_CONF_VERSION is increased each time build/conf/bblayers.conf
# changes incompatibly
POKY_BBLAYERS_CONF_VERSION = "2"

BBPATH = "${TOPDIR}"
BBFILES ?= ""

BBLAYERS ?= " \
  /workdir/resource-rpi/source-rpi/layers/poky/meta \
  /workdir/resource-rpi/source-rpi/layers/poky/meta-poky \
  /workdir/resource-rpi/source-rpi/layers/poky/meta-yocto-bsp \
  /workdir/resource-rpi/source-rpi/layers/meta-openembedded/meta-oe \
  /workdir/resource-rpi/source-rpi/layers/meta-openembedded/meta-perl \
  /workdir/resource-rpi/source-rpi/layers/meta-openembedded/meta-python \
  /workdir/resource-rpi/source-rpi/layers/meta-openembedded/meta-networking \
  /workdir/resource-rpi/source-rpi/layers/meta-openembedded/meta-multimedia \
  /workdir/resource-rpi/source-rpi/layers/meta-raspberrypi \
  /workdir/resource-rpi/source-rpi/layers/meta-rpi5-custom \
  "
```
